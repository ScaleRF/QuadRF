/dts-v1/;
/plugin/;

/ {
	compatible = "brcm,bcm2712";

	fragment@0 {
		/* Use the CAM/DISP 1 connector on the Pi 5 */
		target = <&csi1>;

		__overlay__ {
			compatible = "acme,fpga-csi-rx", "brcm,rp1-csi";

			/* Enable the node */
			status = "okay";

			/* Parameters */
			acme,raw-bits = <8>;    /* set to <8> for RAW8 */
			acme,dt = <0x2a>;    /* CSI-2 RAW8 data type */
			/* D-PHY tuning selector: 640 chooses the stable range for the
			 * measured 350 MHz DDR source (700 Mbps physical lane rate). */
			acme,mbps   = <640>;
			acme,nlanes = <4>;    /* number of data lanes */

			acme,bytes-per-line = <1024>; /* 1024 pixels, RAW8 -> 1024 bytes */
			acme,lines          = <128>; /* 128 lines per frame */

			jtag-tck-gpios = <&gpio 14 0>;
			jtag-tms-gpios = <&gpio 15 0>;
			jtag-tdo-gpios = <&gpio 18 0>;
			jtag-tdi-gpios = <&gpio 23 0>;
		};
	};
};
